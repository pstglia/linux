## arch/arm/mach-zynq/Kconfig
```kconfig
config ARCH_ZYNQ
	bool "Xilinx Zynq ARM Cortex A9 Platform" if ARCH_MULTI_V7
	select ARM_AMBA
	select ARM_GIC
	select HAVE_ARM_SCU if SMP
	select HAVE_ARM_TWD if SMP
	select ICST
	select CADENCE_TTC_TIMER
	select MFD_SYSCON
	select ARM_GLOBAL_TIMER if !CPU_FREQ
	help
	  Support for Xilinx Zynq ARM Cortex A9 Platform
```

## drivers/external_drivers/drivers/input/touchscreen/ft5506/Kconfig
```kconfig
config TOUCHSCREEN_FT5506
	tristate "FT5506 touch controller"
	depends on I2C
	help
	  Say Y here if you have a  FT5506 I2C touch controller
	  connected to your system.

	  If unsure, say N.

	  To compile this driver as a module, choose M here: the
	  module will be called FT5506.
```

## drivers/gator/Kconfig
```kconfig
#
# gator driver configuration
#

menuconfig GATOR
	bool "Gator support"

if GATOR

config GATOR_PERF
	tristate "gator driver for ds-5"
	default n
	select PROFILING
	select TRACEPOINTS
	select RING_BUFFER
	select EVENT_TRACING
	select EVENT_POWER_TRACING_DEPRECATED
	select CONTEXT_SWITCH_TRACER
	select TRACING
	select FTRACE
	select ENABLE_DEFAULT_TRACERS
	select BRANCH_PROFILE_NONE
	select PERF_EVENTS
	---help---
		Gator driver is a driver for streamline, which is
		a function in arm's DS-5.
		Strongly recommended that it should be configured
		as a module!
		NOTE
		Enable the High Resolution Timer Support option.
		Enable Use local timer interrupts if you are using
		a Symmetric MultiProcessing (SMP) target.

config GATOR_WITH_MALI_SUPPORT
	bool

choice
	prompt "Enable Mali GPU support in Gator"
	depends on GATOR_PERF
	optional

config GATOR_MALI_400MP
	bool "Mali-400MP"
	select GATOR_WITH_MALI_SUPPORT

config GATOR_MALI_T6XX
	bool "Mali-T604 or Mali-T658"
	select GATOR_WITH_MALI_SUPPORT

endchoice

config GATOR_MALI_PATH
	string "Path to Mali driver"
	depends on GATOR_WITH_MALI_SUPPORT
	default "modules/mali/DX910-SW-99002-r3p2-01rel2/driver/src/devicedrv/mali/"
	help
		The gator code adds this to its include path so it can get the Mali
		trace headers with: #include "linux/mali_linux_trace.h"

endif
```

## drivers/usb/serial/gobiserial/Kconfig
```kconfig
config USB_GOBISERIAL
	tristate "SIMCOM Modem USB Serial driver"
	default y
	help
	  usb serial driver for SIMCOM modem
```

## modules/drivers/gps/Kconfig
```kconfig
menuconfig GPS
	bool "Gps Adapters"
	default n
	---help---
	  Say Y here to enable selecting GPS adapters.
config GPS_BCM4752
	bool "broadcom bcm4752 driver"
	default y
	---help---
	This driver adds support for control broadcom bcm4752 gpio 

if GPS

# Intel MID GPS
source "drivers/external_drivers/drivers/gps/intel_mid_gps/Kconfig"

# TI's ST based wl128x GPS
source "drivers/external_drivers/drivers/gps/wl128x/Kconfig"

endif # GPS
```

## modules/drivers/input/touchscreen/ft5416/Kconfig
```kconfig
config TOUCHSCREEN_FT5416
	tristate "FT5416 touch controller"
	depends on I2C
	help
	  Say Y here if you have a  FT5416 I2C touch controller
	  connected to your system.

	  If unsure, say N.

	  To compile this driver as a module, choose M here: the
	  module will be called FT5416.
```
